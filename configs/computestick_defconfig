## octopi-x86/configs/computestick_defconfig
```kconfig
# ============================================================
#  OctoPi x86 Buildroot Defconfig (2024.02.3)
#  Target: Intel Compute Stick STCK1A32WFC
#  CPU:    Intel Atom Z3735F (x86, 32-bit UEFI)
# ============================================================

# Architecture
BR2_i386=y
BR2_i386_GENERIC=y

# Toolchain
BR2_TOOLCHAIN_BUILDROOT_GLIBC=y
BR2_TOOLCHAIN_BUILDROOT_CXX=y

# System
BR2_TARGET_GENERIC_HOSTNAME="octopi"
BR2_TARGET_GENERIC_ISSUE="OctoPi x86 - Intel Compute Stick"
BR2_TARGET_GENERIC_ROOT_PASSWD="octoprint"
BR2_SYSTEM_DHCP="eth0"
BR2_TARGET_GENERIC_GETTY_PORT="tty1"

# Init system — systemd
BR2_INIT_SYSTEMD=y
BR2_PACKAGE_SYSTEMD_NETWORKD=y
BR2_PACKAGE_SYSTEMD_RESOLVED=y

# Linux Kernel
BR2_LINUX_KERNEL=y
BR2_LINUX_KERNEL_LATEST_VERSION=y
BR2_LINUX_KERNEL_USE_CUSTOM_CONFIG=y
BR2_LINUX_KERNEL_CUSTOM_CONFIG_FILE="$(BR2_EXTERNAL_OCTOPI_PATH)/board/computestick/linux.config"
BR2_LINUX_KERNEL_NEEDS_HOST_LIBELF=y

# Bootloader — GRUB2 with 32-bit EFI (bootia32.efi)
BR2_TARGET_GRUB2=y
BR2_TARGET_GRUB2_I386_EFI=y
BR2_TARGET_GRUB2_BUILTIN_MODULES_EFI="boot linux ext2 fat part_gpt part_msdos normal configfile \
    loopback ls search search_label search_fs_uuid search_fs_file \
    gfxterm font echo all_video loadenv minicmd"
BR2_TARGET_GRUB2_BUILTIN_CONFIG="$(BR2_EXTERNAL_OCTOPI_PATH)/board/computestick/grub-builtin.cfg"

# Root filesystem
BR2_TARGET_ROOTFS_EXT2=y
BR2_TARGET_ROOTFS_EXT2_4=y
BR2_TARGET_ROOTFS_EXT2_SIZE="3G"

# Overlay and post-build scripts
BR2_ROOTFS_OVERLAY="$(BR2_EXTERNAL_OCTOPI_PATH)/overlay"
BR2_ROOTFS_POST_BUILD_SCRIPT="$(BR2_EXTERNAL_OCTOPI_PATH)/board/computestick/post-build.sh"
BR2_ROOTFS_POST_IMAGE_SCRIPT="$(BR2_EXTERNAL_OCTOPI_PATH)/board/computestick/post-image.sh"
BR2_ROOTFS_POST_SCRIPT_ARGS="$(BR2_EXTERNAL_OCTOPI_PATH)/board/computestick/genimage.cfg"

# ============================================================
# Packages
# ============================================================

# Python3 (OctoPrint requirement)
BR2_PACKAGE_PYTHON3=y
BR2_PACKAGE_PYTHON3_PY_LAUNCHER=y
BR2_PACKAGE_PYTHON_SETUPTOOLS=y
BR2_PACKAGE_PYTHON_WHEEL=y

# OctoPrint (custom package)
BR2_PACKAGE_OCTOPRINT=y

# Web / networking
BR2_PACKAGE_HAPROXY=y
BR2_PACKAGE_AVAHI=y
BR2_PACKAGE_AVAHI_DAEMON=y
BR2_PACKAGE_NFTABLES=y
BR2_PACKAGE_LIBCURL=y
BR2_PACKAGE_LIBCURL_CURL=y

# WiFi
BR2_PACKAGE_WPA_SUPPLICANT=y
BR2_PACKAGE_WPA_SUPPLICANT_NL80211=y
BR2_PACKAGE_WPA_SUPPLICANT_PASSPHRASE=y
BR2_PACKAGE_IW=y
BR2_PACKAGE_WIRELESS_REGDB=y
BR2_PACKAGE_CRDA=y

# SSH
BR2_PACKAGE_OPENSSH=y
BR2_PACKAGE_OPENSSH_SERVER=y
BR2_PACKAGE_OPENSSH_CLIENT=y
BR2_PACKAGE_OPENSSH_KEY_UTILS=y

# Serial / USB support
BR2_PACKAGE_USBUTILS=y
BR2_PACKAGE_MINICOM=y

# Linux firmware (RTL8723BS WiFi firmware)
BR2_PACKAGE_LINUX_FIRMWARE=y
BR2_PACKAGE_LINUX_FIRMWARE_RTL8723=y

# Utilities
BR2_PACKAGE_BASH=y
BR2_PACKAGE_NANO=y
BR2_PACKAGE_HTOP=y
BR2_PACKAGE_WGET=y
BR2_PACKAGE_TZDATA=y
BR2_PACKAGE_CA_CERTIFICATES=y
BR2_PACKAGE_DOSFSTOOLS=y
BR2_PACKAGE_E2FSPROGS=y
BR2_PACKAGE_PARTED=y
```

## octopi-x86/package/octoprint/Config.in
```kconfig
config BR2_PACKAGE_OCTOPRINT
    bool "octoprint"
    depends on BR2_PACKAGE_PYTHON3
    depends on BR2_PACKAGE_PYTHON_PIP
    select BR2_PACKAGE_PYTHON_SETUPTOOLS
    select BR2_PACKAGE_PYTHON_WHEEL
    select BR2_PACKAGE_LIBFFI
    select BR2_PACKAGE_OPENSSL
    help
      OctoPrint is the snappy web interface for your 3D printer.

      https://octoprint.org
```
